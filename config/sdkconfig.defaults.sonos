## config/sdkconfig.defaults.sonos
```kconfig
CONFIG_AUDIO_OUTPUT_SONOS=y
CONFIG_OUTPUT_SAMPLE_RATE_44100=y
CONFIG_RESAMPLER_TAPS=16
CONFIG_SENDSPIN_ENABLE=n
CONFIG_ESP_CONSOLE_UART_DEFAULT=y
CONFIG_FREERTOS_HZ=1000
```
